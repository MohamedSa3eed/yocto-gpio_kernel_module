## meta-rpi/conf/layer.conf
```bitbake
# We have a conf and classes directory, add to BBPATH
BBPATH .= ":${LAYERDIR}"

# We have recipes-* directories, add to BBFILES
BBFILES += "${LAYERDIR}/recipes-*/*/*.bb \
            ${LAYERDIR}/recipes-*/*/*.bbappend"

BBFILE_COLLECTIONS += "meta-rpi"
BBFILE_PATTERN_meta-rpi = "^${LAYERDIR}/"
BBFILE_PRIORITY_meta-rpi = "6"

LAYERDEPENDS_meta-rpi = "core"
LAYERSERIES_COMPAT_meta-rpi = "kirkstone"
```
